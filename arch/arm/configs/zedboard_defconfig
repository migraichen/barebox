## arch/arm/configs/zedboard_defconfig
```kconfig
CONFIG_ARCH_ZYNQ=y
CONFIG_MACH_ZEDBOARD=y
CONFIG_AEABI=y
CONFIG_ARM_UNWIND=y
# CONFIG_MEMINFO is not set
CONFIG_MMU=y
CONFIG_STACK_SIZE=0xf000
CONFIG_MALLOC_SIZE=0x8000000
CONFIG_MALLOC_TLSF=y
CONFIG_KALLSYMS=y
CONFIG_CBSIZE=128
CONFIG_CMDLINE_EDITING=y
CONFIG_AUTO_COMPLETE=y
CONFIG_BOOTM_SHOW_TYPE=y
CONFIG_BOOTM_INITRD=y
CONFIG_BOOTM_OFTREE=y
CONFIG_FLEXIBLE_BOOTARGS=y
CONFIG_DEFAULT_ENVIRONMENT_PATH="arch/arm/boards/avnet-zedboard/env"
# CONFIG_CMD_DEVINFO is not set
# CONFIG_CMD_DRVINFO is not set
# CONFIG_CMD_HELP is not set
CONFIG_CMD_BOOT=y
# CONFIG_CMD_BOOTU is not set
CONFIG_CMD_GO=y
CONFIG_CMD_RESET=y
CONFIG_CMD_PARTITION=y
CONFIG_CMD_AUTOMOUNT=y
# CONFIG_CMD_UMOUNT is not set
CONFIG_CMD_NV=y
CONFIG_CMD_EXPORT=y
CONFIG_CMD_GLOBAL=y
CONFIG_CMD_PRINTENV=y
CONFIG_CMD_SAVEENV=y
# CONFIG_CMD_MKDIR is not set
# CONFIG_CMD_PWD is not set
# CONFIG_CMD_RM is not set
# CONFIG_CMD_RMDIR is not set
# CONFIG_CMD_IP_ROUTE_GET is not set
# CONFIG_CMD_CLEAR is not set
CONFIG_CMD_ECHO_E=y
# CONFIG_CMD_MEMCMP is not set
# CONFIG_CMD_MEMCPY is not set
# CONFIG_CMD_MEMSET is not set
CONFIG_CMD_FIRMWARELOAD=y
CONFIG_NET=y
CONFIG_DRIVER_SERIAL_CADENCE=y
CONFIG_DRIVER_NET_MACB=y
CONFIG_SPI_ZYNQ_QSPI=y
CONFIG_MTD=y
# CONFIG_MTD_OOB_DEVICE is not set
CONFIG_MTD_M25P80=y
CONFIG_MCI=y
CONFIG_MCI_STARTUP=y
CONFIG_MCI_ARASAN=y
CONFIG_EEPROM_AT25=y
# CONFIG_PINCTRL is not set
CONFIG_FIRMWARE_ZYNQ7000_FPGA=y
CONFIG_FS_TFTP=y
CONFIG_FS_FAT=y
CONFIG_FS_FAT_WRITE=y
CONFIG_FS_FAT_LFN=y
```

## drivers/firmware/Kconfig
```kconfig
menu "Firmware Drivers"

config FIRMWARE_ALTERA_SERIAL
	bool "Altera SPI programming"
	depends on OFDEVICE
	depends on GENERIC_GPIO
	depends on SPI
	select FIRMWARE
	help
	  Programming an Altera FPGA via a few GPIOs for the control lines and
	  MOSI, MISO and clock from an SPI interface for the data lines

config FIRMWARE_ALTERA_SOCFPGA
	bool "Altera SoCFPGA fpga loader"
	depends on ARCH_SOCFPGA
	select FIRMWARE

config FIRMWARE_ZYNQ7000_FPGA
	bool "Xilinx Zynq 7000 FPGA loader"
	depends on ARCH_ZYNQ
	select FIRMWARE
	help
	  Load a bitstream to the PL of Zynq

config FIRMWARE_ZYNQMP_FPGA
	bool "Xilinx ZynqMP FPGA loader"
	depends on ARCH_ZYNQMP
	select FIRMWARE
	help
	  Load a bitstream to the PL of Zynq Ultrascale+
endmenu
```
